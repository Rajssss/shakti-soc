ISA=RV64IMAFDC
MUL=asic
COREFABRIC=AXI4
SYNTH=SIM
VERBOSITY=0
USERTRAPS=disable
USER=enable
SUPERVISOR=enable
MULSTAGES=0
DIVSTAGES=64
FPGA=xc7a100tcsg324-1
SYNTHTOP=mkriscv
RESETPC=4096
PADDR=32

# Predictor Config
PREDICTOR=gshare_fa
BPURESET=1
BTBDEPTH=32
BHTDEPTH=256
HISTLEN=8
EXTRAHIST=3
RASDEPTH=8
RASTAGDEPTH=64

CAUSESIZE=6
DEBUG=disable
OPENOCD=disable

# Verilator options
COVERAGE=none
TRACE=disable
THREADS=1

# DebugOptions
RTLDUMP=enable
ASSERTIONS=enable

# Instruction cache
ICACHE=enable
ISETS=64
IWORDS=4
IBLOCKS=16
IWAYS=4
IFBSIZE=4
IESIZE=2
IREPL=PLRU
IRESET=1
IDBANKS=1
ITBANKS=1
IBUSWIDTH=64

# Instruction cache
DCACHE=enable
DESIZE=1
DSETS=64
DWORDS=8
DBLOCKS=8
DWAYS=4
DFBSIZE=8
DSBSIZE=2
DREPL=PLRU
DRESET=1
DDBANKS=1
DTBANKS=1

#PIPELINE CONFIG
PIPE=2

#PMP CONFIG
PMP=disable
PMPSIZE=0
ASIDWIDTH=9
